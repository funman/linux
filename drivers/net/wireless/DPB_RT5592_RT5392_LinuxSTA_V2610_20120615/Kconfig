## drivers/net/wireless/DPB_RT5592_RT5392_LinuxSTA_V2610_20120615/Kconfig
```kconfig
config RT5592_STA
	tristate "Ralink RT5592 802.11n STA support"
	select WIRELESS_EXT
	select WEXT_PRIV
	
config  RT5592_STA_WSC
	bool "WSC (WiFi Simple Config)"
	depends on RT5592_STA

config  RRT5592_STA_LLTD
	bool "LLTD (Link Layer Topology Discovery Protocol)"
	depends on RT5592_STA

config  RT55920_STA_NETIF_BLOCK
	bool "NETIF Block"
	depends on RT5592_STA
	help
	Support Net interface block while Tx-Sw queue full

config  RT5592_STA_DLS
	bool "DLS ((Direct-Link Setup) Support"
	depends on RT5592_STA

config  RT5592_80211N_DRAFT3
	bool "802.11n Draft3"
	depends on RT5592_STA

config  RT5592_AUTO_PROVISION
	bool "Auto Provision"
	depends on RT5592_STA

config  RT5592_STA_ETH_CONVERT
	bool "Ethernet Convert"
	depends on RT5592_STA

config  RT5592_STA_P2P
	bool "WiFi Direct"
	depends on RT5592_STA

config  RT5592_STA_FLASH
        bool "FLASH Mode"
        depends on RT5592_STA
```

## net/bridge/Kconfig
```kconfig
#Oct 29, 2012--Modifications were made by U-Media Communication, inc.
#
# 802.1d Ethernet Bridging
#

config BRIDGE
	tristate "802.1d Ethernet Bridging"
	select LLC
	select STP
	---help---
	  If you say Y here, then your Linux box will be able to act as an
	  Ethernet bridge, which means that the different Ethernet segments it
	  is connected to will appear as one Ethernet to the participants.
	  Several such bridges can work together to create even larger
	  networks of Ethernets using the IEEE 802.1 spanning tree algorithm.
	  As this is a standard, Linux bridges will cooperate properly with
	  other third party bridge products.

	  In order to use the Ethernet bridge, you'll need the bridge
	  configuration tools; see <file:Documentation/networking/bridge.txt>
	  for location. Please read the Bridge mini-HOWTO for more
	  information.

	  If you enable iptables support along with the bridge support then you
	  turn your bridge into a bridging IP firewall.
	  iptables will then see the IP packets being bridged, so you need to
	  take this into account when setting up your firewall rules.
	  Enabling arptables support when bridging will let arptables see
	  bridged ARP traffic in the arptables FORWARD chain.

	  To compile this code as a module, choose M here: the module
	  will be called bridge.

	  If unsure, say N.

config BRIDGE_IGMP_SNOOPING
	bool "IGMP/MLD snooping"
	depends on BRIDGE
	depends on INET
	default y
	---help---
	  If you say Y here, then the Ethernet bridge will be able selectively
	  forward multicast traffic based on IGMP/MLD traffic received from
	  each port.

	  Say N to exclude this support and reduce the binary size.

	  If unsure, say Y.

#2012-06-12, David Lin, [Merge from linux-2.6.21 of SDK3.6.0.0]
#+++Ricky CAO: Below is added for U-Media proprietary functions.
config BRIDGE_UMEDIA_PREDEFINED_URL
	bool "U-Media Predefined URL function support"
	depends on BRIDGE
	---help---
	  provide user to browser the GUI of STA device by predefined URL.
#---Ricky CAO: Above is added for U-Media proprietary functions.	  

#Ricky Cao: following is added for enable/disable mange by GUI via WLAN
config BRIDGE_UMEDIA_WLAN_MANAGE
	bool "U-Media function for control if allow manage device by GUI via wlan"
	depends on BRIDGE
	---help---
	  U-Media function for control if allow manage device by GUI via wlan.
#Ricky Cao added DONE

#support redirect url to configuration web, tim.wang@u-media.com.tw, 2012-12-14
config BRIDGE_UMEDIA_REDIRECT_URL
	bool "U-Media redirect URL to web configuration"
	depends on BRIDGE
	---help---
	  all URL request will be redirected to the configuration web before connect to AP.
```
